## prj.conf
```kconfig
CONFIG_USE_SEGGER_RTT=y
CONFIG_RTT_CONSOLE=y
CONFIG_UART_CONSOLE=n
CONFIG_SERIAL=n
CONFIG_PRINTK=y
#CONFIG_HAS_SEGGER_RTT=y

CONFIG_SERIAL=y
CONFIG_STDOUT_CONSOLE=y
```

## src/main.c
```c
/*
 * Copyright (c) 2012-2014 Wind River Systems, Inc.
 *
 * SPDX-License-Identifier: Apache-2.0
 */

#include <zephyr.h>
#include <sys/printk.h>

void main(void)
{
	printk("Hellololo Worldd!\n");
	printk("Hello Worllld! %s\n", CONFIG_BOARD);
}
```
